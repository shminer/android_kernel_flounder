## arch/arm64/hotplug/Kconfig
```kconfig
config INTELLI_HOTPLUG
	bool "Enable intelli-plug cpu hotplug driver"
	default y
	help
	  Generic Intelli-plug cpu hotplug driver for ARM SOCs

config ALUCARD_HOTPLUG
	bool "Enable alucard-hotplug cpu hotplug driver"
	default y
	help
	  Generic Alucard-hotplug cpu hotplug driver for ARM SOCs
```
